## conf/bblayers.conf.sample
```bitbake
POKY_BBLAYERS_CONF_VERSION = "2"

BBPATH = "${TOPDIR}"
BBFILES ?= ""

BBLAYERS ?= " \
    ##OEROOT##/meta \
    ##OEROOT##/meta-poky \
    ##OEROOT##/meta-yocto-bsp \
    ##OEROOT##/meta-openembedded/meta-oe \
    ##OEROOT##/meta-openembedded/meta-python \
    ##OEROOT##/meta-openembedded/meta-networking \
    ##OEROOT##/meta-openembedded/meta-filesystems \
    ##OEROOT##/meta-raspberrypi \
    ##OEROOT##/meta-elk \
    ##OEROOT##/meta-raspberrypi-elk \
    ##OEROOT##/meta-elkpi \
    ##OEROOT##/meta-swupdate \
"
# uncomment to enable qt5 in image
# BBLAYERS += "OEROOT/meta-qt5 "
```

## conf/local.conf.sample
```bitbake
MACHINE = "raspberrypi4-64"

DISTRO = "elk"
DL_DIR = "${TOPDIR}/../downloads"

PACKAGE_CLASSES ?= "package_ipk"

EXTRA_IMAGE_FEATURES ?= "debug-tweaks"
USER_CLASSES ?= "buildstats"
PATCHRESOLVE = "noop"
BB_DISKMON_DIRS ??= "\
    STOPTASKS,${TMPDIR},1G,100K \
    STOPTASKS,${DL_DIR},1G,100K \
    STOPTASKS,${SSTATE_DIR},1G,100K \
    STOPTASKS,/tmp,100M,100K \
    ABORT,${TMPDIR},100M,1K \
    ABORT,${DL_DIR},100M,1K \
    ABORT,${SSTATE_DIR},100M,1K \
    ABORT,/tmp,10M,1K"
do_image_complete[deptask] += "do_populate_lic"
PACKAGECONFIG:append:pn-qemu-native = " sdl"
PACKAGECONFIG:append:pn-nativesdk-qemu = " sdl"
CONF_VERSION = "1"

SECURITY_STRINGFORMAT = "-Wformat -Wformat-security"

RPI_KERNEL_DEVICETREE:remove = "broadcom/bcm2711-rpi-400.dtb broadcom/bcm2711-rpi-cm4.dtb"
RPI_KERNEL_DEVICETREE_OVERLAYS:remove = "overlays/vc4-kms-dsi-7inch.dtbo"

INHERIT += "rm_work"
ENABLE_UART = "1"
RPI_USE_U_BOOT = "1"
SERIAL_CONSOLES = "57600;ttyS0"

# set the host name of device
SWU_VERSION = "1.0.0"

VST2SDK_PATH = ""
LICENSE_FLAGS_ACCEPTED += "commercial"
EXTRA_IMAGE_FEATURES = " debug-tweaks ssh-server-openssh package-management"
KERNEL_IMAGETYPE_raspberrypi4-64 = "Image.gz"
# set the host name of device
hostname:pn-base-files = "elk-pi"

# Comment the following for qt image
BBMASK += "meta-elkpi/recipes-images/images/elkpi-audio-os-image-qt.bb"
BBMASK += "meta-elk/recipes-qt/simple-qt/simple-qt_0.1.bb"
BBMASK += "meta-elk/recipes-qt/qt/qtbase_git.bbappend"
#BBMASK += "meta-raspberrypi/recipes-kernel/linux/linux-raspberrypi_5.4.bb"
# By default, mda-vst2 plugins are not installed in the image and SUSHI will not
# have VST2 support enabled. If you have access to the VST2 SDK you can enable
# both by setting the variable VST2SDK_PATH to the path of the vst2 sdk as
# follows:
# VST2SDK_PATH = "path/to/the/vst2sdk/in/your/build/machine/"
# For example : VST2SDK_PATH = "/home/user/vstsdk2.4"
# To disable VST2 support, just define `VST2SDK_PATH` as an empty string.

# To generate sdk with x11 libs
#IMAGE_INSTALL:append = " packagegroup-core-x11 \
# libxcursor libxcursor-dev \
# libxinerama libxinerama-dev \
# "
```

## wic/elkpi-usb.wks
```
# short-description: Create Elk Pi USB bootable image
# long-description: Creates a partitioned USB image for use with
# Elk Pi. Boot files are located in the first vfat partition.

part --source bootimg-partition --ondisk sda --fstype=vfat --label boot --active --align 4096 --size 40
part / --source rootfs --ondisk sda --fstype=ext4 --label rootfs1 --align 1024 --size 2048M --use-uuid
part / --source rootfs --ondisk sda --fstype=ext4 --label rootfs2 --align 1024 --size 2048M --use-uuid
part --ondisk sda --fstype=ext4 --label userdata --align 1024 --size 2048M
```

## wic/elkpi.wks
```
# short-description: Create Elk Pi SD card image
# long-description: Creates a partitioned SD card image for use with
# Elk Pi. Boot files are located in the first vfat partition.

part --source bootimg-partition --ondisk mmcblk0 --fstype=vfat --label boot --active --align 4096 --size 40
part / --source rootfs --ondisk mmcblk0 --fstype=ext4 --label rootfs1 --align 1024 --size 2048M --use-uuid
part / --source rootfs --ondisk mmcblk0 --fstype=ext4 --label rootfs2 --align 1024 --size 2048M --use-uuid
part --ondisk mmcblk0 --fstype=ext4 --label userdata --align 1024 --size 2048M
```

## wic/sika.wks
```
# short-description: Create Raspberry Pi SD card image
# long-description: Creates a partitioned SD card image for use with
# Raspberry Pi. Boot files are located in the first vfat partition.

part /boot --source bootimg-partition --ondisk mmcblk0 --fstype=vfat --label boot --active --align 4096 --size 20
part / --source rootfs --ondisk mmcblk0 --fstype=ext4 --label root --align 4096 --size 2096M --use-uuid
part /udata --ondisk mmcblk0 --fstype=ext4 --label userdata --align 1024 --size 4096M
```
